## conf/layer.conf
```bitbake
BBPATH .= ":${LAYERDIR}"

BBFILES += "${LAYERDIR}/recipes-*/*/*.bb \
            ${LAYERDIR}/recipes-*/*/*.bbappend"

BBFILE_COLLECTIONS += "meta-mmg-images"
BBFILE_PATTERN_meta-mmg-images = "^${LAYERDIR}/"
BBFILE_PRIORITY_meta-mmg-images = "6"

LAYERDEPENDS_meta-mmg-images = " \
	toradex-demos \
"
LAYERSERIES_COMPAT_meta-mmg-images = "kirkstone"

hostname:pn-base-files = "streamy"

LICENSE_FLAGS_ACCEPTED += " commercial"
```
